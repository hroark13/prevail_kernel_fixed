## drivers/dpram/Kconfig
```kconfig
# Dpram configuration
#

menu "Dpram support"

config DPRAM
       tristate "Using smem as dpram"
       default y
       ---help---
		Include this for using smem as dpram for communication between modem and appl.
endmenu
```

## drivers/i2c/chips/Kconfig
```kconfig
#
# Miscellaneous I2C chip drivers configuration
#
# *** DEPRECATED! Do not add new entries! See Makefile ***
#

menu "Miscellaneous I2C Chip support"

config DS1682
	tristate "Dallas DS1682 Total Elapsed Time Recorder with Alarm"
	depends on EXPERIMENTAL
	help
	  If you say yes here you get support for Dallas Semiconductor
	  DS1682 Total Elapsed Time Recorder.

	  This driver can also be built as a module.  If so, the module
	  will be called ds1682.

config SENSORS_PCF8574
	tristate "Philips PCF8574 and PCF8574A (DEPRECATED)"
	depends on EXPERIMENTAL && GPIO_PCF857X = "n"
	default n
	help
	  If you say yes here you get support for Philips PCF8574 and 
	  PCF8574A chips. These chips are 8-bit I/O expanders for the I2C bus.

	  This driver can also be built as a module.  If so, the module
	  will be called pcf8574.

	  This driver is deprecated and will be dropped soon. Use
	  drivers/gpio/pcf857x.c instead.

	  These devices are hard to detect and rarely found on mainstream
	  hardware.  If unsure, say N.

config PCF8575
	tristate "Philips PCF8575 (DEPRECATED)"
	default n
	depends on GPIO_PCF857X = "n"
	help
	  If you say yes here you get support for Philips PCF8575 chip.
	  This chip is a 16-bit I/O expander for the I2C bus.  Several other
	  chip manufacturers sell equivalent chips, e.g. Texas Instruments.

	  This driver can also be built as a module.  If so, the module
	  will be called pcf8575.

	  This driver is deprecated and will be dropped soon. Use
	  drivers/gpio/pcf857x.c instead.

	  This device is hard to detect and is rarely found on mainstream
	  hardware.  If unsure, say N.

config SENSORS_PCA9539
	tristate "Philips PCA9539 16-bit I/O port (DEPRECATED)"
	depends on EXPERIMENTAL && GPIO_PCA953X = "n"
	help
	  If you say yes here you get support for the Philips PCA9539
	  16-bit I/O port.

	  This driver can also be built as a module.  If so, the module
	  will be called pca9539.

	  This driver is deprecated and will be dropped soon. Use
	  drivers/gpio/pca953x.c instead.

config SENSORS_PCF8591
	tristate "Philips PCF8591"
	depends on EXPERIMENTAL
	default n
	help
	  If you say yes here you get support for Philips PCF8591 chips.

	  This driver can also be built as a module.  If so, the module
	  will be called pcf8591.

	  These devices are hard to detect and rarely found on mainstream
	  hardware.  If unsure, say N.

config SENSORS_MAX6875
	tristate "Maxim MAX6875 Power supply supervisor"
	depends on EXPERIMENTAL
	help
	  If you say yes here you get support for the Maxim MAX6875
	  EEPROM-programmable, quad power-supply sequencer/supervisor.

	  This provides an interface to program the EEPROM and reset the chip.

	  This driver also supports the Maxim MAX6874 hex power-supply
	  sequencer/supervisor if found at a compatible address.

	  This driver can also be built as a module.  If so, the module
	  will be called max6875.

config SENSORS_TSL2550
	tristate "Taos TSL2550 ambient light sensor"
	depends on EXPERIMENTAL
	help
	  If you say yes here you get support for the Taos TSL2550
	  ambient light sensor.

	  This driver can also be built as a module.  If so, the module
	  will be called tsl2550.

config SENSORS_AKM8976
	tristate "AKM8976 Compass Driver"
	depends on I2C
	help
	 AKM8976 Compass Driver implemented by HTC.

config SENSORS_AKM8973
	tristate "AKM8973 Compass Driver"
	depends on I2C
	help
	 AKM8973 Compass Driver implemented by HTC.

config SENSORS_PCA963X
	tristate "Philips PCA963X 4-bit I2C-bus LED"
	depends on I2C && EXPERIMENTAL
	help
	 If you say yes here you get support for the Philips PCA963X
	 4-bit I2C-bus LED.

	 This driver can also be built as a module.  If so, the module
	 will be called pca963X.

config SENSORS_MT9T013
	tristate "MT9T013 Camera Driver"
	depends on I2C
	default y
	help
	 MT9T013 Camera Driver implemented by HTC.

config VP_A1026
	tristate "A1026 Voice Processor Driver"
	depends on I2C
	help
	  A1026 Voice Processor Driver implemented by HTC.

config AMP_MAX97000
	bool "Maxim MAX97000 Amp Subsystem Driver"
	depends on I2C 
	default n

config FSA9280
	bool "Fairchild FSA9280 USB switch Driver"
	depends on I2C
	default y

config SENSORS_BMA_ACCEL
	tristate "BMA acceleration sensor support"
	depends on I2C=y
	default n
	help
	  If you say yes here you get support for Bosch Sensortec's 
	  acceleration sensors BMA.
	  
config SENSORS_KR3D_ACCEL
	tristate "KR3DM acceleration sensor support"
	depends on I2C=y
	default n
	help
	  If you say yes here you get support for Kr3dm 
	  acceleration sensors .
	
config INPUT_KR3DH_POSITION
	int "KR3DH Mounting Position on Board"
	depends on SENSORS_KR3D_ACCEL
	default "0"
	help
	  Chip mounting position (pin 1).
	    0: top, upper-left
	    1: top, upper-right
	    2: top, lower-right
	    3: top, lower-left
	    4: bottom, upper-left
	    5: bottom, upper-right
	    6: bottom, lower-right
	    7: bottom, lower-left

config SENSORS_MMC31XX
	tristate "MEMSIC Magnetic Sensor Driver Support"
	depends on I2C
	default n
	help
	  If you say yes here you get support for the MEMSIC magnateic sensor

config SENSORS_MMC328X
	tristate "MEMSIC Magnetic Sensor Driver Support"
	depends on I2C
	default n
	help
	  If you say yes here you get support for the MEMSIC magnateic sensor

config ECOMPASS
	tristate "MEMSIC eCompass Sensor Driver Support"
	depends on I2C
	default y
	help
	  If you say yes here you get support for the MEMSIC magnateic sensor

config SENSORS_OPTICAL                                                              
	bool "Optical Sensor"
	default n
	help
	This option enables proximity & light sensors

config SENSORS_OPTICAL_GP2A
	depends on SENSORS_OPTICAL
	tristate "GP2A driver for msm7x27"
	default n
	help
	  This option enables proximity & light sensors using gp2a driver.
	  It is optimized for msm7x27.	  

config AMP_MAX97000
	bool "Maxim MAX97000 Amp Subsystem Driver"
	depends on I2C 
	default n

config FSA9280
	bool "Fairchild FSA9280 USB switch Driver"
	depends on I2C
	default y

config SENSORS_BMA_ACCEL
	tristate "BMA acceleration sensor support"
	depends on I2C=y
	default n
	help
	  If you say yes here you get support for Bosch Sensortec's 
	  acceleration sensors BMA.


config ECOMPASS
	tristate "MEMSIC eCompass Sensor Driver Support"
	depends on I2C
	default y
	help
	  If you say yes here you get support for the MEMSIC magnateic sensor

config SENSORS_OPTICAL                                                              
	bool "Optical Sensor"
	default n
	help
	This option enables proximity & light sensors

config SENSORS_OPTICAL_GP2A
	depends on SENSORS_OPTICAL
	tristate "GP2A driver for msm7x27"
	default n
	help
	  This option enables proximity & light sensors using gp2a driver.
	  It is optimized for msm7x27.	  

config SENSORS_TAOS
	tristate "TAOS sensor support"
	depends on I2C=y
	default n
	help
	  If you say yes here you get support for TAOS's proximity sensor.

endmenu
```

## drivers/param/Kconfig
```kconfig
menu "Samsung Param support"
menuconfig ENABLE_MSM_PARAM
	tristate "Samsung Paramter Block system"
	depends on ARCH_MSM7X27
	default	n
	help
	  Samsung Android Phone - Parameter control driver
	  samsung_flash.o

menuconfig MSM_PARAM
	tristate "Samsung Paramter Block system"
	depends on ARCH_MSM7X27
	default	m
	help
	  Samsung Android Phone - Parameter control driver
	  samsung_flash.o
endmenu
```
